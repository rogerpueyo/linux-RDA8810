## arch/arm/mach-rda/Kconfig
```kconfig
if ARCH_RDA

menu "RDA SoCs Support"

config ARCH_RDA8810
	bool "RDA8810 SoC"
	select CACHE_L2X0
	help
	  RDA8810 SoC based systems

config MACH_RDA8810
	bool "RDA8810 based mach"
	select ARCH_RDA8810
	select CLKDEV_LOOKUP
	select COMMON_CLK
	select CLK_RDA
	help
	  RDA8810 based Board

config CLK_RDA
	bool
	depends on ARCH_RDA
	help
	  RDA clock tree

config RDA_SLEEP_OFF_MODE
	bool "Support shutdown CPU when sleep"
	depends on ARCH_RDA && PM
	default n
	help
	  Select if we want to shutdown/reset CPU when sleep

endmenu

endif
```
